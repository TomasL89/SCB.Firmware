#include "Arduino.h"
#include "Display.h"

#include "Arduino.h"
#include "Arduino_GFX_Library.h"
#include "Fonts/FreeSans9pt7b.h"
#include "Adafruit_I2CDevice.h"

Arduino_DataBus *bus; // = new Arduino_HWSPI(LCD_DC_PIN, LCD_CS_PIN);
Arduino_GFX *tft;	  // = new Arduino_GC9A01(bus, LCD_RST_PIN, 0, true);

// Color definitions
#define UI_PURPLE 0xB1DF
#define UI_PINK 0xFA2F
#define UI_RED 0xFA8A
#define UI_ORANGE 0xFC69
#define UI_YELLOW 0xFEC8
#define UI_BLUE 0x44BF
#define UI_GREEN 0x3730
#define UI_BLACK 0x2104
#define UI_GREY 0x8430
#define UI_WHITE 0xF7BE
#define UI_PAPER_WHITE 0xF7BD

// Math constants
#define PI 3.1415926535897932384626433832795

Display::Display(int lcdCSPin, int lcdDCPin, int lcdRstPin, int lcdBlPin)
{
	bus = new Arduino_HWSPI(lcdDCPin, lcdCSPin);
	tft = new Arduino_GC9A01(bus, lcdRstPin, 0, true);
	tft->begin();
	tft->setRotation(1);
	tft->setFont(&FreeSans9pt7b);
	tft->fillScreen(UI_BLACK);
	tft->setCursor(120, 120);
	tft->setTextSize(2);
}

// Icons
const unsigned char coffee_cup_small[] PROGMEM = {
	0x00, 0x20, 0x10, 0x08, 0x00, 0x00, 0x00, 0x78, 0x3c, 0x1c, 0x00, 0x00, 0x00, 0x38, 0x1c, 0x0e,
	0x00, 0x00, 0x00, 0x38, 0x1c, 0x0e, 0x00, 0x00, 0x00, 0x1c, 0x0e, 0x07, 0x00, 0x00, 0x00, 0x1c,
	0x0e, 0x07, 0x00, 0x00, 0x00, 0x38, 0x1c, 0x0e, 0x00, 0x00, 0x00, 0x78, 0x3c, 0x1e, 0x00, 0x00,
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	0xff, 0xff, 0xfc, 0x00, 0xff, 0xff, 0xff, 0xff, 0xfe, 0x00, 0x7f, 0xff, 0xff, 0xff, 0xfc, 0x00};

// 32x32px
const unsigned char thermometer_small[] PROGMEM = {
	0x00, 0x0f, 0xf0, 0x00, 0x00, 0x1f, 0xf8, 0x00, 0x00, 0x1f, 0xf8, 0x00, 0x00, 0x3c, 0x3c, 0x00,
	0x00, 0x38, 0x1c, 0x00, 0x00, 0x38, 0x1c, 0x00, 0x00, 0x38, 0x1c, 0x00, 0x00, 0x38, 0x1c, 0x00,
	0x00, 0x38, 0x1c, 0x00, 0x00, 0x38, 0x1c, 0x00, 0x00, 0x38, 0x1c, 0x00, 0x00, 0x38, 0x1c, 0x00,
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	0x00, 0x7c, 0x3e, 0x00, 0x00, 0x7f, 0xfe, 0x00, 0x00, 0x3f, 0xfc, 0x00, 0x00, 0x0f, 0xf0, 0x00};

// 32x32px
const unsigned char wifi_small[] PROGMEM = {
	0x00, 0x00, 0x00, 0x00, 0x00, 0x00, 0x00, 0x00, 0x00, 0x07, 0xe0, 0x00, 0x00, 0x7f, 0xfe, 0x00,
	0x03, 0xff, 0xff, 0xc0, 0x0f, 0xff, 0xff, 0xf0, 0x1f, 0xe0, 0x07, 0xf8, 0x3f, 0x80, 0x01, 0xfc,
	0x7e, 0x00, 0x00, 0x7e, 0xf8, 0x00, 0x00, 0x1f, 0xf0, 0x1f, 0xf8, 0x0f, 0xe0, 0xff, 0xff, 0x07,
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	0x00, 0x03, 0xc0, 0x00, 0x00, 0x01, 0x80, 0x00, 0x00, 0x00, 0x00, 0x00, 0x00, 0x00, 0x00, 0x00};

// 32x32px
const unsigned char cloud_small[] PROGMEM = {
	0x00, 0x00, 0x00, 0x00, 0x00, 0x00, 0x00, 0x00, 0x00, 0x00, 0x00, 0x00, 0x00, 0x00, 0x00, 0x00,
	0x00, 0x00, 0x00, 0x00, 0x00, 0x00, 0x00, 0x00, 0x00, 0x3e, 0x00, 0x00, 0x00, 0xff, 0x80, 0x00,
	0x03, 0xff, 0xc0, 0x00, 0x03, 0xc3, 0xff, 0x00, 0x07, 0x80, 0xff, 0xc0, 0x07, 0x00, 0xff, 0xe0,
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	0x00, 0x00, 0x00, 0x00, 0x00, 0x00, 0x00, 0x00, 0x00, 0x00, 0x00, 0x00, 0x00, 0x00, 0x00, 0x00};

// 32x32px
const unsigned char clock_small[] PROGMEM = {
	0x00, 0x3f, 0xfc, 0x00, 0x00, 0xff, 0xff, 0x00, 0x03, 0xff, 0xff, 0xc0, 0x07, 0xe0, 0x07, 0xe0,
	0x0f, 0x80, 0x01, 0xf0, 0x1f, 0x00, 0x00, 0xf8, 0x3e, 0x01, 0x80, 0x7c, 0x3c, 0x01, 0x80, 0x3c,
	0x78, 0x01, 0x80, 0x1e, 0x70, 0x01, 0x80, 0x0e, 0xf0, 0x01, 0x80, 0x0f, 0xe0, 0x01, 0x80, 0x07,
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	0x07, 0xe0, 0x07, 0xe0, 0x03, 0xff, 0xff, 0xc0, 0x00, 0xff, 0xff, 0x00, 0x00, 0x3f, 0xfc, 0x00};

// 32x32px
const unsigned char guage_small[] PROGMEM = {
	0x00, 0x00, 0x00, 0x00, 0x00, 0x00, 0x00, 0x00, 0x00, 0x07, 0xe0, 0x00, 0x00, 0x3f, 0xfc, 0x00,
	0x00, 0xff, 0xff, 0x00, 0x01, 0xfd, 0xbf, 0x80, 0x03, 0xe1, 0x87, 0xc0, 0x07, 0xc1, 0x83, 0xe0,
	0x0f, 0xe0, 0x07, 0xf0, 0x0f, 0xe1, 0x87, 0xf0, 0x1e, 0xc3, 0xc3, 0x78, 0x1c, 0x03, 0xc0, 0x38,
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	0x00, 0x3f, 0xfc, 0x00, 0x00, 0x07, 0xe0, 0x00, 0x00, 0x00, 0x00, 0x00, 0x00, 0x00, 0x00, 0x00};

const unsigned char eco_leaf[] PROGMEM = {
	0x00, 0x00, 0x00, 0x00, 0x00, 0x00, 0x7f, 0xff, 0x00, 0x00, 0x00, 0x00, 0x00, 0xff, 0xff, 0xff,
	0x00, 0x00, 0x00, 0x00, 0x1f, 0xff, 0xff, 0xff, 0x00, 0x00, 0x00, 0x03, 0xff, 0xff, 0x00, 0x1e,
	0x00, 0x00, 0x00, 0x1f, 0xff, 0x00, 0x00, 0x3c, 0x00, 0x00, 0x00, 0xff, 0xc0, 0x00, 0x00, 0x78,
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	0xe0, 0x00, 0x00, 0x00, 0x00, 0x00, 0x00, 0x00, 0xc0, 0x00, 0x00, 0x00, 0x00, 0x00, 0x00, 0x00};

// 48x48px
const unsigned char jug_small[] PROGMEM = {
	0x00, 0x00, 0x07, 0x39, 0x80, 0x00, 0x00, 0x00, 0x07, 0x7b, 0xc0, 0x00, 0x00, 0x00, 0x0f, 0xfb,
	0x80, 0x00, 0x00, 0x00, 0x0e, 0xf7, 0x80, 0x00, 0x00, 0x00, 0x0f, 0xff, 0x80, 0x00, 0x00, 0x00,
	0x0f, 0x7b, 0x80, 0x00, 0x00, 0x00, 0x07, 0x7b, 0xc0, 0x00, 0x00, 0x00, 0x0f, 0x7b, 0x80, 0x00,
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	0xff, 0xff, 0xff, 0xc0, 0x00, 0x3f, 0xff, 0xff, 0xff, 0xc0, 0x00, 0x1f, 0xff, 0xff, 0xff, 0x80};

// 32x32px
const unsigned char profile[] PROGMEM = {
	0x00, 0x00, 0x00, 0x00, 0x00, 0x00, 0x00, 0x00, 0x00, 0x00, 0x00, 0x1e, 0x00, 0x00, 0x00, 0x3f,
	0x00, 0x00, 0x00, 0x33, 0x00, 0x00, 0x00, 0x33, 0x00, 0x00, 0x00, 0x3f, 0x00, 0x38, 0x00, 0x1e,
	0x00, 0x7c, 0x00, 0x38, 0x00, 0x6e, 0x00, 0x30, 0x00, 0xe6, 0x00, 0x60, 0x00, 0x6e, 0x00, 0xe0,
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	0xfc, 0x00, 0x00, 0x00, 0x78, 0x00, 0x00, 0x00, 0x00, 0x00, 0x00, 0x00, 0x00, 0x00, 0x00, 0x00};

// 32x32px
const unsigned char info[] PROGMEM = {
	0x00, 0x00, 0x00, 0x00, 0x00, 0x00, 0x00, 0x00, 0x00, 0x00, 0x00, 0x00, 0x00, 0x1f, 0xf8, 0x00,
	0x00, 0x7f, 0xfe, 0x00, 0x00, 0xfe, 0x7f, 0x00, 0x01, 0xe0, 0x07, 0x80, 0x03, 0xc0, 0x03, 0xc0,
	0x07, 0x80, 0x01, 0xe0, 0x0f, 0x01, 0x80, 0xf0, 0x0e, 0x01, 0x80, 0x70, 0x1c, 0x01, 0x80, 0x38,
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	0x00, 0x1f, 0xf8, 0x00, 0x00, 0x00, 0x00, 0x00, 0x00, 0x00, 0x00, 0x00, 0x00, 0x00, 0x00, 0x00};

const unsigned char back_arrow[] PROGMEM = {
	0x00, 0x00, 0x00, 0x00, 0x00, 0x00, 0x00, 0x00, 0x00, 0x00, 0x00, 0x00, 0x00, 0x00, 0x00, 0x00,
	0x00, 0x18, 0x00, 0x00, 0x00, 0x38, 0x00, 0x00, 0x00, 0x78, 0x00, 0x00, 0x00, 0xf0, 0x00, 0x00,
	0x01, 0xe0, 0x00, 0x00, 0x03, 0xc0, 0x00, 0x00, 0x07, 0x80, 0x00, 0x00, 0x0f, 0x00, 0x00, 0x00,
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	0x00, 0x00, 0x00, 0x00, 0x00, 0x00, 0x00, 0x00, 0x00, 0x00, 0x00, 0x00, 0x00, 0x00, 0x00, 0x00};

const unsigned char back_array_large[] PROGMEM = {
	0x00, 0x00, 0x00, 0x00, 0x00, 0x00, 0x00, 0x00, 0x00, 0x00, 0x00, 0x00, 0x00, 0x00, 0x00, 0x00,
	0x00, 0x00, 0x00, 0x00, 0x00, 0x00, 0x00, 0x00, 0x00, 0x00, 0x00, 0x00, 0x00, 0x00, 0x00, 0x00,
	0x00, 0x00, 0x00, 0x00, 0x00, 0x00, 0x00, 0x00, 0x00, 0x00, 0x00, 0x00, 0x00, 0x00, 0x00, 0x00,
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	0x00, 0x00, 0x00, 0x00, 0x00, 0x00, 0x00, 0x00, 0x00, 0x00, 0x00, 0x00, 0x00, 0x00, 0x00, 0x00};

// 64x64px
const unsigned char profile_library[] PROGMEM = {
	0x00, 0x00, 0x00, 0x00, 0x00, 0x00, 0x00, 0x00, 0x00, 0x00, 0x00, 0x00, 0x00, 0x00, 0x00, 0x00,
	0x00, 0x00, 0x00, 0x00, 0x00, 0x00, 0x00, 0x00, 0x00, 0x00, 0x00, 0x00, 0x00, 0x00, 0x00, 0x00,
	0x03, 0xfc, 0x03, 0xfc, 0x00, 0x38, 0x00, 0x00, 0x07, 0xfe, 0x07, 0xfe, 0x03, 0xfe, 0x00, 0x00,
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	0x00, 0x00, 0x00, 0x00, 0x00, 0x00, 0x00, 0x00, 0x00, 0x00, 0x00, 0x00, 0x00, 0x00, 0x00, 0x00};

// 64x64px
const unsigned char new_profile[] PROGMEM = {
	0x00, 0x00, 0x00, 0x00, 0x00, 0x00, 0x07, 0xe0, 0x00, 0x00, 0x00, 0x00, 0x00, 0x00, 0x1f, 0xf8,
	0x00, 0x00, 0x00, 0x00, 0x00, 0x00, 0x3f, 0xfc, 0x00, 0x00, 0x00, 0x00, 0x00, 0x00, 0x7f, 0xfe,
	0x00, 0x00, 0x00, 0x00, 0x00, 0x00, 0xff, 0xfe, 0x00, 0x00, 0x00, 0x00, 0x00, 0x01, 0xfe, 0xff,
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	0x1f, 0xff, 0xff, 0xff, 0xff, 0xff, 0xc0, 0x00, 0x07, 0xff, 0xff, 0xff, 0xff, 0xff, 0x80, 0x00};

// 'back-button', 48x48px
const unsigned char back_button[] PROGMEM = {
	0x00, 0x00, 0x1f, 0xf8, 0x00, 0x00, 0x00, 0x01, 0xff, 0xff, 0x80, 0x00, 0x00, 0x07, 0xff, 0xff,
	0xe0, 0x00, 0x00, 0x1f, 0xfc, 0x3f, 0xf8, 0x00, 0x00, 0x3f, 0x80, 0x01, 0xfc, 0x00, 0x00, 0xfe,
	0x00, 0x00, 0x7f, 0x00, 0x01, 0xf8, 0x00, 0x00, 0x1f, 0x80, 0x03, 0xf0, 0x00, 0x00, 0x0f, 0xc0,
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	0xff, 0xff, 0xe0, 0x00, 0x00, 0x01, 0xff, 0xff, 0x80, 0x00, 0x00, 0x00, 0x1f, 0xf8, 0x00, 0x00};

// Functions

void plotBarPoint(int x, int y, int pressure, bool abovePressure)
{
	tft->drawCircle(x, y, 1, UI_PAPER_WHITE);
	tft->drawCircle(x, y, 2, UI_PAPER_WHITE);
	tft->drawCircle(x, y, 3, UI_PAPER_WHITE);
	tft->drawCircle(x, y, 4, UI_PINK);

	tft->setTextColor(UI_PINK);

	if (abovePressure)
	{
		tft->setCursor(x - 20, y - 10);
	}
	else
	{
		tft->setCursor(x - 20, y + 20);
	}
	tft->print(pressure);
	tft->print(" bar");
}

void Display::drawEspressoPage(int temperature)
{
	int degreesXOffset = 75;
	int degreesYOffset = 30;
	int xBasePosition = 80;

	int temperatureYPosition = 140;

	tft->fillScreen(UI_PAPER_WHITE);
	tft->drawBitmap(xBasePosition + 15, 15, coffee_cup_small, 48, 48, UI_BLACK);

	tft->drawBitmap(xBasePosition, 180, wifi_small, 32, 32, UI_BLACK);

	tft->drawBitmap(xBasePosition + 40, 180, cloud_small, 32, 32, UI_BLACK);

	tft->setTextSize(4);
	tft->setCursor(xBasePosition, temperatureYPosition);
	tft->setTextColor(UI_PINK);

	switch (temperature)
	{
	case -100:
		tft->println("E1");
		break;
	case -200:
		tft->println("E2");
		break;
	case -300:
		tft->println("E3");
		break;
	case -400:
		tft->println("E4");
		break;
	case -500:
		tft->println("E5");
		break;
	default:
		tft->println(temperature);
		tft->setTextSize(2);
		tft->setCursor(xBasePosition + degreesXOffset, temperatureYPosition - degreesYOffset); // 135, 95
		tft->print("o");
		break;
	}
}

void Display::drawSteamPage(int temperature)
{
	int degreesXOffset = 75;
	int degreesYOffset = 30;
	int xBasePosition = 80;

	int temperatureYPosition = 140;

	tft->fillScreen(UI_PAPER_WHITE);
	tft->drawBitmap(xBasePosition + 15, 15, jug_small, 48, 48, UI_BLACK);

	tft->drawBitmap(xBasePosition, 180, wifi_small, 32, 32, UI_BLACK);

	tft->drawBitmap(xBasePosition + 40, 180, cloud_small, 32, 32, UI_BLACK);

	if (temperature > 99)
	{
		xBasePosition -= 30;
		degreesXOffset += 40;
	}

	tft->setTextSize(4);
	tft->setCursor(xBasePosition, temperatureYPosition);
	tft->setTextColor(UI_PINK);
	tft->println(temperature);

	tft->setTextSize(2);
	tft->setCursor(xBasePosition + degreesXOffset, temperatureYPosition - degreesYOffset); // 135, 95
	tft->print("o");
}

// works but is complicated
void Display::drawEspressoPreview(int temperature, int pressure[60], int profileTime)
{
	int xBasePosition = 90;
	int timeStepInPx = 160 / profileTime;
	int pressureStepInPx = 100 / 15;
	int pressureZeroPointY = 180;
	int pressureZeroPointX = 40;

	tft->fillScreen(UI_PAPER_WHITE);
	tft->drawBitmap(xBasePosition, 15, thermometer_small, 32, 32, UI_BLACK);
	tft->setTextSize(1);
	tft->setCursor(xBasePosition + 32, 38);
	tft->setTextColor(UI_BLACK);

	switch (temperature)
	{
	case -100:
		tft->println("E1");
		break;
	case -200:
		tft->println("E2");
		break;
	case -300:
		tft->println("E3");
		break;
	case -400:
		tft->println("E4");
		break;
	case -500:
		tft->println("E5");
		break;
	default:
		tft->println(temperature);
		break;
	}

	int lastPressure = 0;
	int maxPressure = 0;
	int peakCount = 0;
	int peakMidPoint = 0;
	int peakStart = -1;
	int peakEnd = -1;

	// find max
	for (int i = 0; i < profileTime; i++)
	{
		if (pressure[i] > maxPressure)
		{
			maxPressure = pressure[i];
		}
	}

	// find end of max peak and stop
	for (int i = 0; i < profileTime; i++)
	{
		if (pressure[i] == maxPressure)
		{
			peakCount++;
			if (peakStart < 0)
			{
				peakStart = i;
			}
		}
		else if (pressure[i] < maxPressure && peakStart >= 0)
		{
			peakEnd = i;
			break;
		}
	}

	peakMidPoint = peakEnd - (peakCount / 2);

	for (int i = 0; i < profileTime; i++)
	{
		int pressurePoint = pressure[i] * pressureStepInPx;
		int yValue = pressureZeroPointY - pressurePoint;
		int secondStartPoint = pressureZeroPointX + (i * timeStepInPx);
		int secondEndPoint = secondStartPoint + (1 * timeStepInPx);

		tft->drawLine(secondStartPoint, yValue, secondEndPoint, yValue, UI_PINK);

		if (i == 0)
		{
			plotBarPoint(pressureZeroPointX, yValue, pressure[i], true);
		}

		if (lastPressure > pressure[i] && i != 0)
		{
			int difference = lastPressure - pressure[i];
			int endYValue = yValue - (difference * pressureStepInPx);
			tft->drawLine(secondStartPoint, yValue, secondStartPoint, endYValue, UI_PINK);
		}
		else if (lastPressure < pressure[i] && i != 0)
		{
			int difference = pressure[i] - lastPressure;
			int endYValue = yValue + (difference * pressureStepInPx);
			tft->drawLine(secondStartPoint, yValue, secondStartPoint, endYValue, UI_PINK);
		}

		if (i == peakMidPoint)
		{
			plotBarPoint(secondStartPoint, yValue, pressure[i], true);
		}

		if (i == profileTime - 1)
		{
			if (lastPressure < pressure[i])
			{
				plotBarPoint(secondStartPoint, yValue, pressure[i], true);
			}
			else
			{
				plotBarPoint(secondStartPoint, yValue, pressure[i], false);
			}
		}

		lastPressure = pressure[i];
	}
	tft->setTextColor(UI_BLACK);
	tft->drawBitmap(xBasePosition, 200, clock_small, 32, 32, UI_BLACK);
	tft->setCursor(xBasePosition + 36, 223);
	tft->print(profileTime);
	tft->print("s");
}

void Display::drawEspressoProgress(int second, int temperature, int pressureReading, int pressure[60], int profileTime)
{
	int xBasePosition = 90;
	int timeStepInPx = 160 / profileTime;
	int pressureStepInPx = 120 / 10; // was 15
	int pressureZeroPointY = 190;
	int pressureZeroPointX = 40;

	int lastPressure = 0;

	tft->setTextSize(1);
	tft->fillScreen(UI_PAPER_WHITE);
	tft->drawBitmap(xBasePosition - 32, 15, thermometer_small, 32, 32, UI_BLACK);
	tft->setCursor(xBasePosition, 38);
	tft->setTextColor(UI_BLACK);

	switch (temperature)
	{
	case -100:
		tft->println("E1");
		break;
	case -200:
		tft->println("E2");
		break;
	case -300:
		tft->println("E3");
		break;
	case -400:
		tft->println("E4");
		break;
	case -500:
		tft->println("E5");
		break;
	default:
		tft->println(temperature);
		break;
	}

	if (temperature >= 99)
	{
		tft->drawBitmap(xBasePosition + 32, 18, guage_small, 32, 32, UI_BLACK);
		tft->setCursor(xBasePosition + 68, 38);
	}
	else if (temperature < 99)
	{
		tft->drawBitmap(xBasePosition + 24, 18, guage_small, 32, 32, UI_BLACK);
		tft->setCursor(xBasePosition + 60, 38);
	}

	tft->setTextColor(UI_PINK);
	tft->print(pressureReading);
	tft->setTextColor(UI_BLACK);
	tft->print("/");
	tft->print(pressure[second]);

	for (int i = 0; i < profileTime; i++)
	{
		int pressurePoint = pressure[i] * pressureStepInPx;
		int yValue = pressureZeroPointY - pressurePoint;
		int secondStartPoint = pressureZeroPointX + (i * timeStepInPx);
		int secondEndPoint = secondStartPoint + (1 * timeStepInPx);

		tft->drawLine(secondStartPoint, yValue, secondEndPoint, yValue, UI_PINK);

		if (lastPressure > pressure[i] && i != 0)
		{
			int difference = lastPressure - pressure[i];
			int endYValue = yValue - (difference * pressureStepInPx);
			tft->drawLine(secondStartPoint, yValue, secondStartPoint, endYValue, UI_PINK);
		}
		else if (lastPressure < pressure[i] && i != 0)
		{
			int difference = pressure[i] - lastPressure;
			int endYValue = yValue + (difference * pressureStepInPx);
			tft->drawLine(secondStartPoint, yValue, secondStartPoint, endYValue, UI_PINK);
		}

		lastPressure = pressure[i];
	}

	int progressDotX = pressureZeroPointX + (timeStepInPx * second);
	int progressDotY = pressureZeroPointY - (pressureStepInPx * pressure[second]);

	tft->drawCircle(progressDotX, progressDotY, 1, UI_PAPER_WHITE);
	tft->drawCircle(progressDotX, progressDotY, 2, UI_PAPER_WHITE);
	tft->drawCircle(progressDotX, progressDotY, 3, UI_PAPER_WHITE);
	tft->drawCircle(progressDotX, progressDotY, 4, UI_PINK);

	tft->setTextColor(UI_BLACK);
	tft->drawBitmap(xBasePosition, 200, clock_small, 32, 32, UI_BLACK);
	tft->setCursor(xBasePosition + 36, 223);
	tft->print(second);
	tft->print("s");
}

void Display::drawProgressPage(int second, int profileTime, int temperature, int pressure, bool screenSet)
{
	if (!screenSet)
	{
		tft->fillScreen(UI_BLACK);
	}
	int circleX = 50;
	int circleY = 180;
	float radius = 92.0;
	if (second == 1)
	{
		tft->fillCircle(circleX, circleY, 7, UI_PINK);
	}

	float startAngle = 140;
	// float blockSize = 275.00/float(profileTime + 1);
	// float blockSize = 265.00/float(profileTime - 1);
	float blockSize = 265.00 / float(profileTime);
	float nextAngle = startAngle + (blockSize * second);

	tft->fillArc(120, 120, 100, 85, startAngle, nextAngle, UI_PINK);
	int newPointX = (radius * cos(nextAngle * PI / 180.00)) + 120;
	int newPointY = (radius * sin(nextAngle * PI / 180.00)) + 120; // pow(radius, 2) - pow(circleX, 2));
	tft->fillRect(45, 120, 150, 2, UI_PINK);					   // was 45

	if (second > (profileTime / 2))
	{
		tft->fillCircle(newPointX + 1, newPointY + 1, 7, UI_PINK);
	}
	else
	{
		tft->fillCircle(newPointX, newPointY, 7, UI_PINK);
	}

	tft->fillRect(70, 65, 50, 50, UI_BLACK);

	tft->setCursor(70, 100);
	tft->setTextSize(2);
	tft->setTextColor(UI_WHITE);
	tft->print(String(temperature));
	tft->drawCircle(124, 80, 4, UI_GREY);
	tft->setCursor(120, 100);
	tft->setTextColor(UI_GREY);
	tft->print(" C");

	tft->fillRect(60, 130, 30, 55, UI_BLACK);
	tft->setCursor(70, 160);
	tft->setTextColor(UI_WHITE);
	tft->print(String(pressure));
	tft->setTextColor(UI_GREY);
	tft->print(" Bar");

	tft->fillRect(70, 165, 100, 50, UI_BLACK);
	tft->setTextColor(UI_PINK);
	tft->setCursor(90, 210);
	tft->setTextSize(2);
	tft->print(String(second) + "s");
}

void Display::drawCycleFinishedPage(int cycleCount)
{
	int cycleOffset = 15;
	tft->fillScreen(UI_PAPER_WHITE);

	if (cycleCount >= 99 && cycleCount < 999)
	{
		cycleOffset = 10;
	}
	else if (cycleCount >= 999 && cycleCount <= 9999)
	{
		cycleOffset = 0;
	}
	else if (cycleCount > 9999)
	{
		cycleOffset = -5;
	}

	int xBasePosition = 80;
	tft->drawBitmap(xBasePosition + 15, 15, coffee_cup_small, 48, 48, UI_BLACK);
	tft->setTextColor(UI_PINK);
	tft->setTextSize(2);
	tft->setCursor(xBasePosition + cycleOffset, 120);
	tft->println(cycleCount);
	tft->setCursor(xBasePosition - 15, 150);
	tft->println("cycles");
	tft->setTextColor(UI_BLACK);
	tft->setCursor(xBasePosition, 210);
	tft->println("Done");
}

void Display::drawHomePage(int position)
{
	tft->fillScreen(UI_WHITE);
	if (position == 1)
	{
		tft->drawBitmap(70, 185, profile, 32, 32, UI_PINK);
		tft->drawBitmap(110, 200, thermometer_small, 32, 32, UI_BLACK);
		tft->drawBitmap(150, 185, info, 32, 32, UI_BLACK);
	}
	else if (position == 2)
	{
		tft->drawBitmap(70, 185, profile, 32, 32, UI_BLACK);
		tft->drawBitmap(110, 200, thermometer_small, 32, 32, UI_PINK);
		tft->drawBitmap(150, 185, info, 32, 32, UI_BLACK);
	}
	else if (position == 3)
	{
		tft->drawBitmap(70, 185, profile, 32, 32, UI_BLACK);
		tft->drawBitmap(110, 200, thermometer_small, 32, 32, UI_BLACK);
		tft->drawBitmap(150, 185, info, 32, 32, UI_PINK);
	}
}

void Display::drawTemperaturePage(int position, int espressoTemperature, int steamTemperature)
{
	// clear the top part, we still want the bottom
	tft->fillScreen(UI_WHITE);
	if (position == 1)
	{
		tft->drawBitmap(60, 50, coffee_cup_small, 48, 48, UI_PINK);
		tft->setTextSize(2);
		tft->setCursor(115, 90);
		tft->setTextColor(UI_PINK);
		tft->print(espressoTemperature);

		tft->drawBitmap(60, 110, jug_small, 48, 48, UI_BLACK);
		tft->setCursor(115, 150);
		tft->setTextColor(UI_BLACK);
		tft->print(steamTemperature);

		tft->drawBitmap(80, 170, back_button, 48, 48, UI_BLACK);
	}
	else if (position == 2)
	{
		tft->drawBitmap(60, 50, coffee_cup_small, 48, 48, UI_BLACK);
		tft->setTextSize(2);
		tft->setCursor(115, 90);
		tft->setTextColor(UI_BLACK);
		tft->print(espressoTemperature);

		tft->drawBitmap(60, 110, jug_small, 48, 48, UI_PINK);
		tft->setTextSize(2);
		tft->setCursor(115, 150);
		tft->setTextColor(UI_PINK);
		tft->print(steamTemperature);

		tft->drawBitmap(80, 170, back_button, 48, 48, UI_BLACK);
	}
	else if (position == 3)
	{
		tft->drawBitmap(60, 50, coffee_cup_small, 48, 48, UI_BLACK);
		tft->setTextSize(2);
		tft->setCursor(115, 90);
		tft->setTextColor(UI_BLACK);
		tft->print(espressoTemperature);

		tft->drawBitmap(60, 110, jug_small, 48, 48, UI_BLACK);
		tft->setTextSize(2);
		tft->setCursor(115, 150);
		tft->setTextColor(UI_BLACK);
		tft->print(steamTemperature);

		tft->drawBitmap(80, 170, back_button, 48, 48, UI_PINK);
	}
}

void Display::drawEditingTemperature(int position, int newTemperature, bool flash)
{
	tft->setTextSize(2);
	tft->setTextColor(UI_PINK);

	if (position == 1)
	{
		tft->fillRect(115, 50, 60, 50, UI_WHITE);

		if (flash)
		{
			return;
			// tft->fillRect(115, 90, 60, 50, UI_WHITE);
		}
		else
		{
			tft->setCursor(115, 90);
			tft->print(newTemperature);
		}
	}
	else if (position == 2)
	{
		tft->fillRect(115, 110, 60, 50, UI_WHITE);

		if (flash)
		{
			return;
		}
		else
		{
			tft->setCursor(115, 150);
			tft->print(newTemperature);
		}
	}
}

// don't use
void Display::drawProfilePage(int subPosition)
{
	tft->fillScreen(UI_WHITE);
	if (subPosition == 1)
	{
		tft->drawBitmap(20, 80, back_array_large, 64, 64, UI_PINK);
		tft->drawBitmap(90, 80, profile_library, 64, 64, UI_BLACK);
		tft->drawBitmap(160, 80, new_profile, 64, 64, UI_BLACK);
	}
	else if (subPosition == 2)
	{
		tft->drawBitmap(20, 80, back_array_large, 64, 64, UI_BLACK);
		tft->drawBitmap(90, 80, profile_library, 64, 64, UI_PINK);
		tft->drawBitmap(160, 80, new_profile, 64, 64, UI_BLACK);
	}
	else if (subPosition == 3)
	{
		tft->drawBitmap(20, 80, back_array_large, 64, 64, UI_BLACK);
		tft->drawBitmap(90, 80, profile_library, 64, 64, UI_BLACK);
		tft->drawBitmap(160, 80, new_profile, 64, 64, UI_PINK);
	}
}

void Display::drawPumpCalibration(int targetPressure, float currentPressure, int currentPower, int sensorReading)
{
	tft->setTextSize(1);
	tft->fillScreen(UI_WHITE);
	tft->setTextColor(UI_BLACK);
	tft->setCursor(40, 40);
	tft->print("Target: ");
	tft->print(targetPressure);
	tft->print(" Bar");
	tft->setCursor(40, 60);
	tft->print("Current: ");
	tft->print(currentPressure);
	tft->print(" Bar");
	tft->setCursor(40, 80);
	tft->print("Power: ");
	tft->print(currentPower);
	tft->print(" %");
	tft->setCursor(40, 100);
	tft->print("Power: ");
	tft->print(sensorReading);
	tft->print(" mV");
}

// experimental area
void Display::drawSimpleProgressPage(int temperature, int pressure, int currentTime, int shotTime)
{
	tft->fillScreen(UI_WHITE);
	tft->drawFastVLine(120, 0, 240, UI_BLACK);
	tft->drawFastHLine(0, 120, 240, UI_BLACK);
	tft->fillArc(120, 120, 110, 100, 105, 255, UI_PURPLE);
	tft->fillArc(120, 120, 110, 100, 285, 75, UI_BLUE);
}

void Display::drawDiagnostics(int targetTemperature, int currentTemperature, bool steamMode, int currentPower, int pidPoint, bool connectedToWiFi)
{
	tft->setTextSize(1);
	tft->fillScreen(UI_WHITE);
	tft->setTextColor(UI_BLACK);
	tft->setCursor(40, 40);
	tft->print("Target: ");
	tft->print(targetTemperature);
	tft->print(" C");
	tft->setCursor(40, 60);
	tft->print("Current: ");
	tft->print(currentTemperature);
	tft->print(" C");
	tft->setCursor(40, 80);
	tft->print("Power: ");
	tft->print(currentPower);
	tft->print(" %");
	tft->setCursor(40, 100);
	tft->print("PID: ");
	tft->print(pidPoint);
	tft->setCursor(40, 120);
	tft->print("Steam Mode: ");
	tft->print(steamMode);
	tft->setCursor(40, 140);
	tft->print("WiFi: ");
	tft->print(connectedToWiFi);
}
